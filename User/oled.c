/*********************************************************
  @2017CameraDemo
  @固件库：超核V2.4
  @author：wgq & lq
  @2017.11.27
  @for seu2017 摄像头组
*********************************************************/
#include "oled.h"

//常用ASCII表
//偏移量32

//ASCII字符集
//偏移量32
//大小:12*6
const unsigned char asc2_1206[95][12]={
{0x00,0x00,0x00,0x00,0x00,0x00,0x00,0x00,0x00,0x00,0x00,0x00},/*" ",0*/
{0x00,0x00,0x00,0x00,0x3F,0x40,0x00,0x00,0x00,0x00,0x00,0x00},/*"!",1*/
{0x00,0x00,0x30,0x00,0x40,0x00,0x30,0x00,0x40,0x00,0x00,0x00},/*""",2*/
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{0x40,0x00,0x80,0x00,0x40,0x00,0x20,0x00,0x20,0x00,0x40,0x00},/*"~",94*/
}; 
const unsigned char asc2_1608[95][16]={	  
{0x00,0x00,0x00,0x00,0x00,0x00,0x00,0x00,0x00,0x00,0x00,0x00,0x00,0x00,0x00,0x00},/*" ",0*/
{0x00,0x00,0x00,0x00,0x00,0x00,0x1F,0xCC,0x00,0x0C,0x00,0x00,0x00,0x00,0x00,0x00},/*"!",1*/
{0x00,0x00,0x08,0x00,0x30,0x00,0x60,0x00,0x08,0x00,0x30,0x00,0x60,0x00,0x00,0x00},/*""",2*/
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{0x00,0x00,0x60,0x00,0x80,0x00,0x80,0x00,0x40,0x00,0x40,0x00,0x20,0x00,0x20,0x00},/*"~",94*/
};      


//SSD1306 OLED 驱动IC驱动代码
//驱动方式:8080并口/4线串口
//版本:V1.1
//正点原子@ALIENTEK
//2010-6-3


//OLED的显存
/*存放格式如下.
[0]0 1 2 3 ... 127	
[1]0 1 2 3 ... 127	
[2]0 1 2 3 ... 127	
[3]0 1 2 3 ... 127	
[4]0 1 2 3 ... 127	
[5]0 1 2 3 ... 127	
[6]0 1 2 3 ... 127	
[7]0 1 2 3 ... 127 	
*/	   
uint8_t OLED_GRAM[128][8];	 



/*
* @name		OLED_WR_Byte
* @description	向SSD1306写入一个字节。
* @inputval	dat:要写入的数据/命令
* 		cmd:数据/命令标志 0,表示命令;1,表示数据;
* @outputval	None
* @retval 	0
*/ 
void OLED_WR_Byte(uint8_t dat,uint8_t cmd)
{	
	uint8_t i;			  
	OLED_RS=cmd; //写命令 
	OLED_CS=0;		  
	for(i=0;i<8;i++)
	{			  
		OLED_SCLK=0;
		if(dat&0x80)OLED_SDIN=1;
		else OLED_SDIN=0;
		OLED_SCLK=1;
      		dat<<=1;   
      	}				 
	OLED_CS=1;		  
	OLED_RS=1;   	  
} 


/*
* @name		OLED_Refresh_Gram
* @description	Refresh the video memory on OLED screen.(更新OLED显存)
* @inputval	None
* @outputval	None
* @retval 	0
*/ 	 
void OLED_Refresh_Gram(void)
{
	uint8_t i,n;		    
	for(i=0;i<8;i++)  
	{  
		OLED_WR_Byte (0xb0+i,OLED_CMD);    //设置页地址（0~7）
		OLED_WR_Byte (0x02,OLED_CMD);      //设置显示位置—列低地址,偏移了2列
		OLED_WR_Byte (0x10,OLED_CMD);      //设置显示位置—列高地址   
		for(n=0;n<128;n++)
			OLED_WR_Byte(OLED_GRAM[(n+1)%128][i],OLED_DATA); 
	}   
}


	  	  
/*
* @name		OLED_Display_On
* @description	Open the OLED screen.
* @inputval	None
* @outputval	None
* @retval 	0
*/   
void OLED_Display_On(void)
{
	OLED_WR_Byte(0X8D,OLED_CMD);  //SET DCDC命令
	OLED_WR_Byte(0X14,OLED_CMD);  //DCDC ON
	OLED_WR_Byte(0XAF,OLED_CMD);  //DISPLAY ON
}


/*
* @name		OLED_Display_Off
* @description	Turn off the OLED screen.
* @inputval	None
* @outputval	None
* @retval 	0
*/ 
void OLED_Display_Off(void)
{
	OLED_WR_Byte(0X8D,OLED_CMD);  //SET DCDC命令
	OLED_WR_Byte(0X10,OLED_CMD);  //DCDC OFF
	OLED_WR_Byte(0XAE,OLED_CMD);  //DISPLAY OFF
}


/*
* @name		OLED_Clear
* @description	Clear the OLED screen.
* 		清屏函数,清完屏,整个屏幕是黑色的,和没点亮一样。
* @inputval	None
* @outputval	None
* @retval 	0
*/ 
void OLED_Clear(void)  
{  
	uint8_t i,n;  
	for(i=0;i<8;i++)for(n=0;n<128;n++)
		OLED_GRAM[n][i]=0X00;  
	OLED_Refresh_Gram();
}


/*
* @name		OLED_Fill
* @description	Draw a point in specified position on OLED screen.
* @inputval	x	range from 0 to 127
* 		y	range from 0 to 63
* 		t	0,清空;1,填充
* @outputval	None
* @retval 	0
*/		   
void OLED_DrawPoint(uint8_t x,uint8_t y,uint8_t t)
{
	uint8_t pos,bx,temp=0;
	if(x>127||y>63)return;//超出范围了.
	pos=7-y/8;
	bx=y%8;
	temp=1<<(7-bx);

	if(t)OLED_GRAM[x][pos]|=temp;
	else OLED_GRAM[x][pos]&=~temp;	    
}


/*
* @name		OLED_Fill
* @description	Fill a area in specified position on OLED screen.
* @inputval	x1,y1,x2,y2 	填充区域的对角坐标(确保x1<=x2;y1<=y2 0<=x1<=127 0<=y1<=63	)
* 		dot				0,清空;1,填充
* @outputval	None
* @retval 	0
*/
void OLED_Fill(uint8_t x1,uint8_t y1,uint8_t x2,uint8_t y2,uint8_t dot)  
{  
	uint8_t x,y;  
	for(x=x1;x<=x2;x++)
	{
		for(y=y1;y<=y2;y++)OLED_DrawPoint(x,y,dot);
	}													    
	// OLED_Refresh_Gram();//更新显示
}


/*
* @name		OLED_ShowChar
* @description	Show a char in specified position on OLED screen.
* @inputval	x	x coordinate,range from 0 to 127(x坐标，范围为从0到127)
* 		y	y coordinate,range from 0 to 63(y坐标，范围为从0到63)
* 		char	the char you want to display(要显示的字符)
* 		size	select the size of char(选择字体16或12)
* 		mode	select the mode, usually is 1(选择显示模式，通常为1。0为反白显示，1为正常显示。)
* @outputval	None
* @retval 	0
*/
void OLED_ShowChar(uint8_t x,uint8_t y,uint8_t chr,uint8_t size,uint8_t mode)
{      			    
	uint8_t temp,t,t1;
	uint8_t y0=y;
	chr=chr-' ';//得到偏移后的值				   
    for(t=0;t<size;t++)
    {   
		if(size==12)temp=asc2_1206[chr][t];  //调用1206字体
		else temp=asc2_1608[chr][t];	//调用1608字体 	                          
        for(t1=0;t1<8;t1++)
		{
			if(temp&0x80)OLED_DrawPoint(x,y,mode);
			else OLED_DrawPoint(x,y,!mode);
			temp<<=1;
			y++;
			if((y-y0)==size)
			{
				y=y0;
				x++;
				break;
			}
		}  	 
    }          
}


/*
* @name		OLED_ShowString_1608
* @description	Show a string in 1608 format on OLED screen.
* @inputval	x	x coordinate(x坐标)
* 		y	y coordinate(y坐标)
* 		p	the pointer to the string you want to display(要显示的字符串的指针)
* 		mode	select the mode, usually is 1(选择显示模式，通常为1)
* @outputval	None
* @retval 	0
*/
void OLED_ShowString_1608(uint8_t x,uint8_t y,uint8_t *p,uint8_t mode)
{     
   while(*p!='\0')
    {       
        OLED_ShowChar(x,y,*p,16,mode);	 
        x+=8;
        p++;
    }  
}


/*
* @name		OLED_ShowString_1206
* @description	Show a string in 1206 format on OLED screen.
* @inputval	x	x coordinate(x坐标)
* 		y	y coordinate(y坐标)
* 		p	the pointer to the string you want to display(要显示的字符串的指针)
* 		mode	select the mode, usually is 1(选择显示模式，通常为1)
* @outputval	None
* @retval 	0
*/
void OLED_ShowString_1206(uint8_t x,uint8_t y, uint8_t *p,uint8_t mode)
{        
    while(*p!='\0')
    {       
        OLED_ShowChar(x,y,*p,12,mode);	 
        x+=6;
        p++;
    }  
}

/*
* @name		OLED_ShowNum_1206
* @description	Show a number in float on OLED screen.
* @inputval	None
* @outputval	None
* @retval 	0
*/
void OLED_ShowNum_1206(uint8_t x, uint8_t y, float num, uint8_t mode)
{
	uint8_t  numStr[10] = "", strCnt = 0, p;
	uint32_t numInt = (uint32_t)(num * 100);
	
	while (numInt != 0) 
	{
            numInt /= 10;
            strCnt++;
	}
	strCnt += 1;
	numStr[strCnt] = '\0';
	numInt = (uint32_t)(num * 100);
	
	p = strCnt - 1;
	while (numInt != 0)
	{
		numStr[p--] = (numInt % 10) + '0';
		numInt /= 10;
		if (p == strCnt - 3)
			numStr[p--] = '.';
	}
	
	OLED_ShowString_1206(x, y, numStr, mode);
}

/*
* @name		Dly_ms_200M
* @description	The function is used to delay in milliseconds of 200MHz PLL.
* @inputval	None
* @outputval	None
* @retval 	0
*/
void 	Dly_ms_200M(void){
  unsigned int  a;
  unsigned char b;
  unsigned char c;

  for(a=0;a<1000;a++){
    for(b=0;b<200;b++){
      for(c=0;c<200;c++){
      }  
    }
  }
}


/*
* @name		OLED_Init
* @description	The function is used to initialise SSD1303.
* @inputval	None
* @outputval	None
* @retval 	0
*/				    
void OLED_Init(void)
{ 	
    //OLED IO初始化
    GPIO_QuickInit(HW_GPIOA, 12, kGPIO_Mode_OPP);
    GPIO_QuickInit(HW_GPIOA, 13, kGPIO_Mode_OPP);
    GPIO_QuickInit(HW_GPIOA, 14, kGPIO_Mode_OPP);
    GPIO_QuickInit(HW_GPIOA, 15, kGPIO_Mode_OPP);
    GPIO_QuickInit(HW_GPIOA, 16, kGPIO_Mode_OPP);
	//蓝宙OLED，使用SPI通信协议。
	//OLED管脚初始化
	OLED_SCLK = 1;
	OLED_RST=0;
	Dly_ms_200M();
	OLED_RST=1; 
	
	OLED_WR_Byte(0xAE,OLED_CMD); //关闭显示
	OLED_WR_Byte(0xD5,OLED_CMD); //设置时钟分频因子,震荡频率
	OLED_WR_Byte(80,  OLED_CMD); //[3:0],分频因子;[7:4],震荡频率
	OLED_WR_Byte(0xA8,OLED_CMD); //设置驱动路数
	OLED_WR_Byte(0X3F,OLED_CMD); //默认0X3F(1/64) 
	OLED_WR_Byte(0xD3,OLED_CMD); //设置显示偏移
	OLED_WR_Byte(0X00,OLED_CMD); //默认为0

	OLED_WR_Byte(0x40,OLED_CMD); //设置显示开始行 [5:0],行数.
													    
	OLED_WR_Byte(0x8D,OLED_CMD); //电荷泵设置
	OLED_WR_Byte(0x14,OLED_CMD); //bit2，开启/关闭
	OLED_WR_Byte(0x20,OLED_CMD); //设置内存地址模式
	OLED_WR_Byte(0x02,OLED_CMD); //[1:0],00，列地址模式;01，行地址模式;10,页地址模式;默认10;
	OLED_WR_Byte(0xA1,OLED_CMD); //段重定义设置,bit0:0,0->0;1,0->127;
	OLED_WR_Byte(0xC0,OLED_CMD); //设置COM扫描方向;bit3:0,普通模式;1,重定义模式 COM[N-1]->COM0;N:驱动路数
	OLED_WR_Byte(0xDA,OLED_CMD); //设置COM硬件引脚配置
	OLED_WR_Byte(0x12,OLED_CMD); //[5:4]配置
		 
	OLED_WR_Byte(0x81,OLED_CMD); //对比度设置
	OLED_WR_Byte(0xEF,OLED_CMD); //1~255;默认0X7F (亮度设置,越大越亮)
	OLED_WR_Byte(0xD9,OLED_CMD); //设置预充电周期
	OLED_WR_Byte(0xf1,OLED_CMD); //[3:0],PHASE 1;[7:4],PHASE 2;
	OLED_WR_Byte(0xDB,OLED_CMD); //设置VCOMH 电压倍率
	OLED_WR_Byte(0x30,OLED_CMD); //[6:4] 000,0.65*vcc;001,0.77*vcc;011,0.83*vcc;
	
	OLED_WR_Byte(0xA4,OLED_CMD); //全局显示开启;bit0:1,开启;0,关闭;(白屏/黑屏)
	OLED_WR_Byte(0xA6,OLED_CMD); //设置显示方式;bit0:1,反相显示;0,正常显示	    						   
	OLED_WR_Byte(0xAF,OLED_CMD); //开启显示	 
	OLED_Clear();
	
	OLED_ShowString_1206(0, 0, (uint8_t *)("OLED"), 1);//初始化成功提示。
	OLED_Refresh_Gram();
    PCout(4)=0;
    PCout(5)=1;
}  
